## arch/arm/mach-mt6572/Kconfig
```kconfig
if ARCH_MT6572

menu "MT6572 Board Support Package"

choice
	bool "Board"

config MT6572_FPGA
	bool "MT6572 FPGA"
	select ARM_GIC
	select ARM_L1_CACHE_SHIFT_6
	help
	  Select if you are using the FPGA board.

config MT6572_EVB_BOARD
        bool "MT6572 EVB BOARD"
        select ARM_GIC
	select ARM_L1_CACHE_SHIFT_6
        help
          Select if you are using an EVB board.

endchoice

config MT6572_FPGA_CA7
	tristate "MT6572 FPGA CA7" 
	depends on MT6572_FPGA
	default n
	help
	    Select if you are using the CA7 FPGA board.

config MAX_DRAM_SIZE_SUPPORT
	hex "The maximum size of the DRAM can be supported in the kernel"
	default 0x10000000
	depends on ARCH_MT6572
	help
		Define the maximum size of the kernel can be supported.
	        If will modify the memory size if it size is smaller than 
                the memory size passed by the boot loader to the MAX_DRAM_SIZE_SUPPORT.
   		Notice that the maximum DRAM size is including the memory size
	        reserved for the modem and the PMEM.

# [LGE_BSP_COMMON] CHANGE_S: 2013-10-15 jongwoo82.lee@lge.com  LGE HW Revision feature
config LGE_L30_REVA
        bool "LGE L30 Model HW Rev.A"
        default n
        help
            Select if you are using the L30 sample which hardware version is Rev.A
# [LGE_BSP_COMMON] CHANGE_E: 2013-10-15 jongwoo82.lee@lge.com  LGE HW Revision feature

config LGE_L50_REVA
        bool "LGE L50 Model HW Rev.A"
        default n
        help
            Select if you are using the L50 sample which hardware version is Rev.A

endmenu


endif
```

## arch/arm/mach-mt6572/lge/Kconfig
```kconfig
#menu "LGE Board Selection"

config MACH_LGE
	bool "mach lge"
	default y
	
config LGE_LUT_KCAL
	bool "lge LUT Kcal"
	default y

config LGE_BOOTLOADER_LOG
	depends on MACH_LGE
	bool "Support LGE bootloader log"
	default n
	help
	        LGE bootloader log

#endmenu
```

## drivers/misc/mediatek/broadcast/Kconfig
```kconfig
# LGE Broadcast Device Driver Support

menu "LGE Broadcast Device Support"

config LGE_BROADCAST_ONESEG
	bool "1Seg Broadcast service"
	depends on (ARCH_MT6572)
	default y
	help
	  Select this if you want to use 1Seg mobile broadcast service

config LGE_BROADCAST_BRAZIL_FREQ
	bool "1Seg Broadcast service"
	depends on (ARCH_MT6572)
	default y
	help
	  Select this if you want to use Latin america(Argentina, Brazil) 1Seg mobile broadcast service Channel(14~64)
source "drivers/broadcast/oneseg/Kconfig"

endmenu
```

## drivers/nfc/Kconfig
```kconfig
#
# Near Field Communication (NFC) devices
#

menu "Near Field Communication (NFC) devices"
	depends on NFC
endmenu

config LGE_NFC
	bool "NFC Device Enabled for LGE"
	default n

config LGE_NFC_PN544_C2
	bool "PN544 C2 NFC driver"
	depends on I2C
	select CRC_CCITT
	default n
	---help---
	  Say yes if you want PN544 Near Field Communication driver.
	  This is for i2c connected version. If unsure, say N here.

	  To compile this driver as a module, choose m here. The module will
	  be called pn544.

config LGE_NFC_PN544_C3
	bool "PN544 C3 NFC driver"
	depends on I2C
	select CRC_CCITT
	default n
	---help---
	  Say yes if you want PN544 Near Field Communication driver.
	  This is for i2c connected version. If unsure, say N here.

	  To compile this driver as a module, choose m here. The module will
	  be called pn544.

config LGE_NFC_PN547
	bool "PN547 NFC driver"
	depends on I2C
	select CRC_CCITT
	default n
	---help---
	  Say yes if you want PN547 Near Field Communication driver.
	  This is for i2c connected version. If unsure, say N here.

	  To compile this driver as a module, choose m here. The module will
	  be called pn547.

config LGE_NFC_PRESTANDBY
	bool "NFC STANBY MODE"
	default n
	---help---
	  Say yes if you want to change a power state of pn544 to stanby mode in Kernel.
	  If unsure, say N here.

config LGE_NFC_MULTICORE_FASTBOOT
	bool "NFC MultiThread"
	default n
	---help---
	  Say yes if multi thread is applied for pre-standby.
	  If unsure, say N here.

config LGE_NFC_SET_IRQ_WAKEUP
	bool "NFC Set IRQ wakeup when NFC ON"
	default n
	---help---
	  Say yes if Set IRQ Wakeup NFC ON.
	  If unsure, say N here.
	 
config LGE_NFC_DEBUG_MESSAGE
	bool "NFC Debug Message"
	default n

config NFC_PN533
	tristate "NXP PN533 USB driver"
	depends on USB
	default n
	---help---
	  NXP PN533 USB driver.
	  This driver provides support for NFC NXP PN533 devices.

	  Say Y here to compile support for PN533 devices into the
	  kernel or say M to compile it as module (pn533).

config NFC_WILINK
	tristate "Texas Instruments NFC WiLink driver"
	depends on TI_ST && NFC_NCI
	default n
	---help---
	  This enables the NFC driver for Texas Instrument's BT/FM/GPS/NFC
	  combo devices. This makes use of shared transport line discipline
	  core driver to communicate with the NFC core of the combo chip.

	  Say Y here to compile support for Texas Instrument's NFC WiLink driver
	  into the kernel or say M to compile it as module.

config NFC_MT6605
	tristate "MT6605 NFC driver"
	default n
	---help---
	MT6605 NFC support.
```
